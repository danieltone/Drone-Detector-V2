## drone_detector/sdkconfig.defaults
```kconfig
# sdkconfig.defaults  —  ESP32-C5 Drone Detector
# These override ESP-IDF Kconfig defaults at build time.
# Run "idf.py menuconfig" to explore all options interactively.

# ── Target ────────────────────────────────────────────────────────────────
# (set-target esp32c5 does this, but listed here for clarity)

# ── Serial console ────────────────────────────────────────────────────────
CONFIG_ESP_CONSOLE_UART_DEFAULT=y
CONFIG_ESP_CONSOLE_UART_BAUDRATE=115200

# ── WiFi ──────────────────────────────────────────────────────────────────
# Keep WiFi in RAM for promiscuous performance
CONFIG_ESP_WIFI_STATIC_RX_BUFFER_NUM=10
CONFIG_ESP_WIFI_DYNAMIC_RX_BUFFER_NUM=32
CONFIG_ESP_WIFI_STATIC_TX_BUFFER=y
CONFIG_ESP_WIFI_STATIC_TX_BUFFER_NUM=16

# ── Bluetooth (NimBLE) ────────────────────────────────────────────────────
CONFIG_BT_ENABLED=y
CONFIG_BT_NIMBLE_ENABLED=y

# Observer role only (passive scanning — no advertising/peripheral needed)
CONFIG_BT_NIMBLE_ROLE_OBSERVER=y
CONFIG_BT_NIMBLE_ROLE_BROADCASTER=n
CONFIG_BT_NIMBLE_ROLE_PERIPHERAL=n
CONFIG_BT_NIMBLE_ROLE_CENTRAL=n

# Extended advertising scan (BT5 — catches DJI and FAA Remote ID on extended ADV)
CONFIG_BT_NIMBLE_EXT_ADV=y

# ── WiFi + BLE coexistence ────────────────────────────────────────────────
# Required for running WiFi promiscuous and BLE scan simultaneously
CONFIG_ESP_COEX_SW_COEXIST_ENABLE=y

# ── FreeRTOS ──────────────────────────────────────────────────────────────
CONFIG_FREERTOS_HZ=1000

# ── Log level ─────────────────────────────────────────────────────────────
# Set to INFO for normal operation; change to DEBUG for troubleshooting
CONFIG_LOG_DEFAULT_LEVEL_INFO=y

# ── Partition table ───────────────────────────────────────────────────────
# "large" table gives ~3 MB factory partition (fits WiFi+BLE firmware)
CONFIG_PARTITION_TABLE_SINGLE_APP_LARGE=y
```

## drone_simulator/sdkconfig.defaults
```kconfig
# sdkconfig.defaults  —  ESP32-C3 Drone Simulator

# ── Serial console ────────────────────────────────────────────────────────────
CONFIG_ESP_CONSOLE_UART_DEFAULT=y
CONFIG_ESP_CONSOLE_UART_BAUDRATE=115200

# ── WiFi ──────────────────────────────────────────────────────────────────────
# Enable raw 802.11 frame injection via esp_wifi_80211_tx()
CONFIG_ESP_WIFI_ENABLE_WPA3_SAE=n
CONFIG_ESP_WIFI_STATIC_RX_BUFFER_NUM=6
CONFIG_ESP_WIFI_DYNAMIC_RX_BUFFER_NUM=16
CONFIG_ESP_WIFI_STATIC_TX_BUFFER=y
CONFIG_ESP_WIFI_STATIC_TX_BUFFER_NUM=8

# ── Bluetooth (NimBLE) ────────────────────────────────────────────────────────
CONFIG_BT_ENABLED=y
CONFIG_BT_NIMBLE_ENABLED=y

# Broadcaster role only (advertising only — no scanning/central)
CONFIG_BT_NIMBLE_ROLE_BROADCASTER=y
CONFIG_BT_NIMBLE_ROLE_OBSERVER=n
CONFIG_BT_NIMBLE_ROLE_PERIPHERAL=n
CONFIG_BT_NIMBLE_ROLE_CENTRAL=n

# ── WiFi + BLE coexistence ────────────────────────────────────────────────────
CONFIG_ESP_COEX_SW_COEXIST_ENABLE=y

# ── FreeRTOS ──────────────────────────────────────────────────────────────────
CONFIG_FREERTOS_HZ=1000

# ── Log level ─────────────────────────────────────────────────────────────────
CONFIG_LOG_DEFAULT_LEVEL_INFO=y

# ── Partition table ───────────────────────────────────────────────────────────
CONFIG_PARTITION_TABLE_SINGLE_APP_LARGE=y
```
